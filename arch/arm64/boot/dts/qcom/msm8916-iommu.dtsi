/* Copyright (c) 2013-2014, The Linux Foundation. All rights reserved.
 *
 * This program is free software; you can redistribute it and/or modify
 * it under the terms of the GNU General Public License version 2 and
 * only version 2 as published by the Free Software Foundation.
 *
 * This program is distributed in the hope that it will be useful,
 * but WITHOUT ANY WARRANTY; without even the implied warranty of
 * MERCHANTABILITY or FITNESS FOR A PARTICULAR PURPOSE.  See the
 * GNU General Public License for more details.
 */

#include "msm-iommu-v2.dtsi"

&soc {
       apps_smmu: arm,smmu@1e00000 {
               compatible = "qcom,smmu-v2";
               reg = <0x1e00000 0x40000
                       0x1ef0000 0x3000>;
               #global-interrupts = <1>;
               interrupts = <0 43 0>,
                            <0 70 0>,
                            <0 70 0>,
                            <0 70 0>,
                            <0 70 0>,
                            <0 70 0>,
                            <0 70 0>,
                            <0 70 0>,
                           <0 70 0>,
                            <0 70 0>,
                             <0 70 0>,
                             <0 70 0>,
                             <0 70 0>,
                             <0 70 0>,
                             <0 70 0>,
                             <0 70 0>,
                            <0 70 0>,
                             <0 70 0>,
                             <0 70 0>,
                             <0 70 0>,
                             <0 70 0>,
                             <0 70 0>,
                             <0 70 0>,
                             <0 70 0>,
                            <0 70 0>,
                             <0 70 0>,
                             <0 70 0>,
                             <0 70 0>,
                             <0 70 0>,
                             <0 70 0>,
                            <0 70 0>;
               #iommu-cells = <1>;
               clocks = <&clock_gcc GCC_SMMU_CFG_CLK>,
                       <&clock_gcc GCC_APPS_TCU_CLK>;
               clock-names = "iface_clk", "core_clk";
               #clock-cells = <1>;
               status = "okay";
       };
 };
