/* Copyright (c) 2014-2015, The Linux Foundation. All rights reserved.
 *
 * This program is free software; you can redistribute it and/or modify
 * it under the terms of the GNU General Public License version 2 and
 * only version 2 as published by the Free Software Foundation.
 *
 * This program is distributed in the hope that it will be useful,
 * but WITHOUT ANY WARRANTY; without even the implied warranty of
 * MERCHANTABILITY or FITNESS FOR A PARTICULAR PURPOSE.  See the
 * GNU General Public License for more details.
 */

&soc {
	venus_smmu: arm,smmu-venus@d40000 {
		status = "disabled";
		compatible = "arm,smmu-v2";
		reg = <0xd40000 0x20000>;
		#iommu-cells = <1>;
        attach-impl-defs = <0x6000 0x70>,
                <0x6060 0x1055>,
                <0x6070 0x110>,
                <0x6074 0x110>,
                <0x6078 0x110>,
                <0x607c 0x110>,
                <0x6080 0x110>,
                <0x6084 0x110>,
                <0x6088 0x110>,
                <0x608c 0x110>,
                <0x6170 0xe1>,
                <0x6174 0xe5>,
                <0x6178 0xfc>,
                <0x617c 0x100>,
                <0x6180 0x104>,
                <0x6184 0x108>,
                <0x6188 0x10c>,
                <0x618c 0x10e>,
                <0x6270 0x0>,
                <0x6274 0x8>,
                <0x6278 0x28>,
                <0x627c 0x69>,
                <0x6280 0x8d>,
                <0x6284 0xa5>,
                <0x6288 0xc9>,
                <0x628c 0xd9>,
                <0x6470 0x0>,
                <0x6474 0x0>,
                <0x6478 0x0>,
                <0x647c 0x0>,
                <0x6480 0x0>,
                <0x6484 0x0>,
                <0x6488 0x0>,
                <0x648c 0x0>,
                <0x6570 0x0>,
                <0x6574 0x4>,
                <0x6578 0x1c>,
                <0x657c 0x21>,
                <0x6580 0x26>,
                <0x6584 0x2a>,
                <0x6588 0x2e>,
                <0x658c 0x30>,
                <0x6670 0x32>,
                <0x6674 0x36>,
                <0x6678 0x46>,
                <0x667c 0x58>,
                <0x6680 0x62>,
                <0x6684 0x6d>,
                <0x6688 0x75>,
                <0x668c 0x7d>,
                <0x67a0 0x0>,
                <0x67a4 0x0>,
                <0x67a8 0x2f>,
                <0x67b0 0x0>,
                <0x67b4 0x0>,
                <0x67b8 0x190>,
                <0x67d0 0x8>,
                <0x67dc 0x8>,
                <0x67e0 0x8>,
                <0x6800 0x0>,
                <0x6804 0x1>,
                <0x6808 0x2>,
                <0x680c 0x3>,
                <0x6810 0x4>,
                <0x6814 0x5>,
                <0x6818 0x6>,
                <0x681c 0x7>,
                <0x6a00 0x6>,
                <0x6b00 0x3ff>,
                <0x6b18 0xff>,
                <0x6b24 0x203>,
                <0x6b28 0x10a00>,
                <0x6b30 0x500>,
                <0x678c 0x18>,
                <0x6794 0x43>;
};
